## boards/shields/oled_adapter/Kconfig.defconfig
```kconfig
# Copyright (c) 2022 The ZMK Contributors
# SPDX-License-Identifier: MIT

if SHIELD_OLED_ADAPTER_PRO_MICRO_128X32 || SHIELD_OLED_ADAPTER_PRO_MICRO_128X64 || SHIELD_OLED_ADAPTER_PRO_MICRO_128X128 || SHIELD_OLED_ADAPTER_SEEEDUINO_XIAO_BLE_128X32 || SHIELD_OLED_ADAPTER_SEEEDUINO_XIAO_BLE_128X64 || SHIELD_OLED_ADAPTER_SEEEDUINO_XIAO_BLE_128X128

if ZMK_DISPLAY

config I2C
    default y

config SSD1306
    default y

endif # ZMK_DISPLAY

endif
```

## boards/shields/oled_adapter/Kconfig.shield
```kconfig
# Copyright (c) 2022 The ZMK Contributors
# SPDX-License-Identifier: MIT

config SHIELD_OLED_ADAPTER_PRO_MICRO_128X32
    def_bool $(shields_list_contains,oled_adapter_pro_micro_128x32)

config SHIELD_OLED_ADAPTER_PRO_MICRO_128X64
    def_bool $(shields_list_contains,oled_adapter_pro_micro_128x64)

config SHIELD_OLED_ADAPTER_PRO_MICRO_128X128
    def_bool $(shields_list_contains,oled_adapter_pro_micro_128x128)

config SHIELD_OLED_ADAPTER_SEEEDUINO_XIAO_BLE_128X32
    def_bool $(shields_list_contains,oled_adapter_seeeduino_xiao_ble_128x32)

config SHIELD_OLED_ADAPTER_SEEEDUINO_XIAO_BLE_128X64
    def_bool $(shields_list_contains,oled_adapter_seeeduino_xiao_ble_128x64)

config SHIELD_OLED_ADAPTER_SEEEDUINO_XIAO_BLE_128X128
    def_bool $(shields_list_contains,oled_adapter_seeeduino_xiao_ble_128x128)
```

## config/west.yml
```yaml
manifest:
  remotes:
    - name: zmkfirmware
      url-base: https://github.com/zmkfirmware
    - name: mctechnology17
      url-base: https://github.com/mctechnology17
  projects:
    - name: zmk
      remote: zmkfirmware
      revision: main
      import: app/west.yml
    - name: zmk-oled-adapter
      remote: mctechnology17
      revision: main
  self:
    path: config
```
