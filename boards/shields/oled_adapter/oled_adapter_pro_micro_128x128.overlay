/*
 * Copyright (c) 2022 The ZMK Contributors
 *
 * SPDX-License-Identifier: MIT
 */

/delete-node/ &oled;

&pro_micro_i2c {
    status = "okay";
    oled_128x128: sh1106@3c {
        compatible = "sinowealth,sh1106";
        reg = <0x3c>;
        width = <120>;
        height = <128>;
        segment-offset = <0>;
        page-offset = <0>;
        display-offset = <0>;
        multiplex-ratio = <119>;
        segment-remap;
        com-invdir;
        inversion-on;
        prechargep = <0x22>;
        };
};

/ {
    chosen {
        zephyr,display = &oled_128x128;
    };
};
// vim: filetype=dts fdm=marker:
